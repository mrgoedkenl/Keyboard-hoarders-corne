## boards/shields/CorneWireless/kconfig.shield
```kconfig
# No whitespace after the comma or in the keyboard name!
config SHIELD_CORNEWIRELESS_DONGLE
    def_bool $(shields_list_contains,CorneWireless_dongle)
```
